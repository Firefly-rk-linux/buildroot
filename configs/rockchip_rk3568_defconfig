## configs/rockchip_rk3568_defconfig
```kconfig
#include "base/base.config"
#include "chips/rk3566_rk3568_aarch64.config"
#include "font/chinese.config"
#include "fs/exfat.config"
#include "fs/ntfs.config"
#include "fs/vfat.config"
#include "gpu/gpu.config"
#include "multimedia/audio.config"
#include "multimedia/camera.config"
#include "multimedia/gst/audio.config"
#include "multimedia/gst/camera.config"
#include "multimedia/gst/rtsp.config"
#include "multimedia/gst/video.config"
#include "multimedia/mpp.config"
#include "wifibt/bt.config"
#include "wifibt/wireless.config"
#include "wifibt/network.config"
#include "qt/qt5.config"
#include "qt/app.config"
#include "benchmark.config"
#include "chromium.config"
#include "debug.config"
#include "debug2.config"
#include "npu2.config"
#include "powermanager.config"
#include "test.config"
#include "weston.config"
BR2_PACKAGE_FIREFLY=y
BR2_PACKAGE_QUECTEL_CM=y
BR2_PACKAGE_UTIL_LINUX_BINARIES=y
```

## configs/rockchip_rk3588_abmc_sub_recovery_defconfig
```kconfig
#include "base/base.config"
#include "chips/rk3588_aarch64.config"


#BR2_PACKAGE_RECOVERY=n
#BR2_PACKAGE_RECOVERY_NO_UI=y


#BR2_PACKAGE_UPDATE=y
#BR2_PACKAGE_RKSCRIPT=y
#BR2_PACKAGE_RKUPDATE=y
#BR2_PACKAGE_OPENSSL=y
#BR2_ROOTFS_OVERLAY="board/rockchip/common/recovery"

BR2_PACKAGE_CURLFTPFS=y
#BR2_PACKAGE_SSHFS=y

BR2_PACKAGE_SQUASHFS=y
BR2_PACKAGE_SQUASHFS_GZIP=y
BR2_PACKAGE_SQUASHFS_LZ4=y
BR2_PACKAGE_SQUASHFS_LZMA=y
BR2_PACKAGE_SQUASHFS_LZO=y
BR2_PACKAGE_SQUASHFS_XZ=y

BR2_PACKAGE_SAMBA4=y
BR2_PACKAGE_NFS_UTILS=y
BR2_PACKAGE_NFS_UTILS_RPC_NFSD=y
BR2_PACKAGE_NILFS_UTILS=y
BR2_PACKAGE_LIBTIRPC=y
BR2_PACKAGE_RPCBIND=y

BR2_PACKAGE_OPENSSH=y
BR2_PACKAGE_OPENSSH_CLIENT=y
```
